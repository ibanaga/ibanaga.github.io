## src/sifive_unleashed_build/fit-linux.its
```
/dts-v1/;

/ {
    description = "HiFive RiscV Linux FIT";
    #address-cells = <1>;

    images {
        kernel {
            description = "Linux kernel";
            data = /incbin/("linux/arch/riscv/boot/Image");
            type = "kernel";
            arch = "riscv";
            os = "linux";
            compression = "none";
            load = <0x80200000>;
            entry = <0x80200000>;
        };

        fdt {
            description = "Device Tree Blob";
            data = /incbin/("linux/arch/riscv/boot/dts/sifive/hifive-unleashed-a00.dtb");
            type = "flat_dt";
            arch = "riscv";
            compression = "none";
            load = <0x88000000>;
        };

        initrd {
            description = "initramfs";
            data = /incbin/("busybox/initrd.cpio.gz");
            type = "ramdisk";
            arch = "riscv";
            os = "linux";
            compression = "none";
            load = <0x88400000>;
        };
    };

    configurations {
        default = "conf";
        conf {
            description = "Boot Linux";
            kernel = "kernel";
            fdt = "fdt";
            ramdisk = "initrd";
        };
    };
};
```

## src/sifive_unleashed_build/hifive_unleashed_uart_defconfig
```kconfig
CONFIG_64BIT=y
CONFIG_RISCV=y
CONFIG_SOC_SIFIVE=y
CONFIG_ARCH_RV64I=y
CONFIG_ARCH_RISCV=y
CONFIG_ARCH_SIFIVE=y
CONFIG_GENERIC_IRQ_CHIP=y
CONFIG_NO_HZ_IDLE=y
CONFIG_HIGH_RES_TIMERS=y
CONFIG_TICK_ONESHOT=y
CONFIG_PREEMPT_NONE=y
CONFIG_SOC_SIFIVE=y

CONFIG_RISCV_SBI=y
CONFIG_RISCV_SBI_V01=y
CONFIG_CMDLINE_BOOL=y
CONFIG_CMDLINE="earlycon console=ttySIF0,115200 debug"

CONFIG_SIFIVE_PLIC=y
CONFIG_SIFIVE_L2=y
CONFIG_CLK_SIFIVE=y

CONFIG_SERIAL_EARLYCON_RISCV_SBI=y
CONFIG_SERIAL_SIFIVE=y
CONFIG_SERIAL_SIFIVE_CONSOLE=y

CONFIG_EXT4_FS=y
CONFIG_VFAT_FS=y
CONFIG_TMPFS=y
CONFIG_DEVTMPFS=y
CONFIG_DEVTMPFS_MOUNT=y

CONFIG_BLK_DEV_SD=y
CONFIG_MMC=y
CONFIG_MMC_SDHCI=y

CONFIG_NET=y
CONFIG_INET=y
CONFIG_ETHERNET=y
CONFIG_SIFIVE_GEM=y

CONFIG_OF=y
CONFIG_BUILD_FDT_RESIZE=y

CONFIG_BLK_DEV_RAM=y
CONFIG_BLK_DEV_INITRD=y
CONFIG_INITRAMFS_SOURCE=""
CONFIG_RD_GZIP=y
```
